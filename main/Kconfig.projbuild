## main/Kconfig.projbuild
```kconfig
menu "Folloup Settings"

    config FOLLOWUP_WIFI_AP_PREFIX
        string "Wi-Fi AP prefix"
        default "Followup"
        help
            Prefix used when the device enters Wi-Fi access-point setup mode.
            The full AP SSID appends the last three Wi-Fi MAC bytes.

    config FOLLOWUP_WIFI_STA_SSID
        string "Built-in Wi-Fi SSID"
        default ""
        help
            Optional built-in station SSID. Runtime-saved NVS credentials take
            precedence when present.

    config FOLLOWUP_WIFI_STA_PASSWORD
        string "Built-in Wi-Fi password"
        default ""
        help
            Optional built-in station password paired with
            FOLLOWUP_WIFI_STA_SSID.

    config FOLLOWUP_WIFI_START_IN_AP_MODE
        bool "Start Wi-Fi in AP setup mode"
        default n
        help
            Start the Wi-Fi backend in access-point setup mode on boot instead
            of first attempting saved or built-in station credentials.

    config FOLLOWUP_TIME_SYNC_DEFAULT_ENABLED
        bool "Enable clock sync by default"
        default y
        help
            When enabled, the timezone service attempts SNTP sync after Wi-Fi
            connects using the configured default timezone.

    config FOLLOWUP_DEFAULT_TIMEZONE_NAME
        string "Default timezone name"
        default "North_America_Eastern"
        help
            Default timezone catalog entry used before a runtime timezone
            setting has been saved in NVS.

    config FOLLOWUP_WELCOME_MESSAGE_ROTATE_HOURS
        int "Dashboard welcome message rotation interval (hours)"
        range 1 720
        default 1
        help
            How many hours between dashboard welcome-message rotations. The
            greeting starts from a random message chosen at boot and advances
            one step every interval, so it changes over time without being
            tied to the calendar.

    config FOLLOWUP_GEMINI_API_KEY
        string "Built-in Gemini API key"
        default ""
        help
            Optional built-in Gemini API key used for testing. A runtime-saved
            Gemini API key stored through the backend portal takes precedence
            when present.

    config FOLLOWUP_AI_PROVIDER
        string "Default AI provider (gemini or localai)"
        default "gemini"
        help
            Selects which backend the provider-neutral AI layer uses by
            default: "gemini" for Google Gemini or "localai" for a
            self-hosted OpenAI-compatible LocalAI server. A runtime-saved
            provider selection stored through the backend portal takes
            precedence when present.

    config FOLLOWUP_LOCALAI_BASE_URL
        string "Built-in LocalAI base URL"
        default ""
        help
            Optional built-in LocalAI server base URL, including the
            OpenAI-compatible API prefix (e.g. http://192.168.1.20:8080/v1).
            A runtime-saved base URL stored through the backend portal takes
            precedence when present.

    config FOLLOWUP_LOCALAI_TEXT_MODEL
        string "Built-in LocalAI text model"
        default "gpt-4"
        help
            Optional built-in LocalAI chat-completions model name. A
            runtime-saved text model stored through the backend portal takes
            precedence when present.

    config FOLLOWUP_LOCALAI_TRANSCRIPTION_MODEL
        string "Built-in LocalAI transcription model"
        default "whisper-1"
        help
            Optional built-in LocalAI audio-transcriptions model name. A
            runtime-saved transcription model stored through the backend
            portal takes precedence when present.

    config FOLLOWUP_LOCALAI_API_KEY
        string "Built-in LocalAI API key"
        default ""
        help
            Optional built-in LocalAI API key for servers configured to
            require one. A runtime-saved key stored through the backend
            portal takes precedence when present.

    config FOLLOWUP_LOCALAI_CONTEXT_LIMIT
        int "Built-in LocalAI context window (tokens)"
        range 256 1000000
        default 8192
        help
            Default context-window budget, in tokens, used to cap prompt
            sizing when LocalAI is the active AI provider. A runtime-saved
            context limit stored through the backend portal takes precedence
            when present.

    config FOLLOWUP_AUTO_SLEEP_DISPLAY_SLEEP_TIMEOUT_SECONDS
        int "Display sleep timeout"
        range 0 86400
        default 180
        help
            Seconds of IMU-detected inactivity before the e-paper panel enters
            display sleep. Set to 0 to disable the display-sleep stage.

    config FOLLOWUP_AUTO_SLEEP_LIGHT_SLEEP_TIMEOUT_SECONDS
        int "Light sleep timeout"
        range 0 86400
        default 1800
        help
            Seconds of IMU-detected inactivity before the ESP32-S3 enters light
            sleep. Set to 0 to disable the light-sleep stage. When both display
            sleep and light sleep are enabled, this value must be greater than
            or equal to the display sleep timeout.

endmenu
```
